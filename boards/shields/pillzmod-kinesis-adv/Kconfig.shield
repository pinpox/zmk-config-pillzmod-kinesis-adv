## boards/shields/pillzmod-kinesis-adv/Kconfig.shield
```kconfig
# Copyright (c) 2020 The ZMK Contributors
# SPDX-License-Identifier: MIT

config SHIELD_PILLZMOD_KINESIS_ADV
   def_bool $(shields_list_contains,pillzmod_kinesis_adv)
```
